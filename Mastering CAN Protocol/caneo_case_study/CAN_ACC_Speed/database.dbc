VERSION ""

NS_ :

BS_:

BU_: ECU2_Speed ECU1_ACC

BO_ 939 speed_Messag2: 1 ECU2_Speed
 SG_ Speed : 0|8@1+ (1,0) [0|255] ""  ECU1_ACC

BO_ 48 ACC_Message: 1 ECU1_ACC
 SG_ ACC_ON : 0|8@1+ (1,0) [0|1] ""  ECU2_Speed
